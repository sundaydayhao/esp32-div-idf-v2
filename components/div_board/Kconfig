## components/div_board/Kconfig
```kconfig
menu "ESP32-DIV hardware"
choice DIV_BOARD
    prompt "Board revision"
    default DIV_BOARD_V3
config DIV_BOARD_V3
    bool "V3"
config DIV_BOARD_V4
    bool "V4"
endchoice
choice DIV_PANEL
    prompt "LCD controller (check module label)"
    default DIV_PANEL_ILI9341 if DIV_BOARD_V3
    default DIV_PANEL_ST7796 if DIV_BOARD_V4
config DIV_PANEL_ILI9341
    bool "ILI9341 240 x 320"
config DIV_PANEL_ST7796
    bool "ST7796 / ST7796S 320 x 480"
endchoice
config DIV_ROTATION
    int "Screen rotation (quarter turns clockwise)"
    range 0 3
    default 0
choice DIV_GPIO2_ROLE
    prompt "GPIO2 population (shared battery divider / buzzer)"
    default DIV_GPIO2_BUZZER
config DIV_GPIO2_DISABLED
    bool "Unconfirmed hardware; leave GPIO2 as input"
config DIV_GPIO2_BATTERY
    bool "Battery ADC (buzzer transistor must be isolated)"
config DIV_GPIO2_BUZZER
    bool "Buzzer output (battery divider must be isolated)"
endchoice
choice DIV_GPIO14_21_ROLE
    prompt "GPIO14/21 population (IR / third NRF24)"
    default DIV_NRF3_ENABLED
config DIV_IR_ENABLED
    bool "IR (NRF24 #3 must be disconnected)"
config DIV_NRF3_ENABLED
    bool "NRF24 #3 (IR transmitter / receiver must be disconnected)"
endchoice
config DIV_GPS_ENABLED
    bool "External GPS connected"
    default n
config DIV_GPS_RX
    int "GPS UART RX GPIO (connect GPS TX here)"
    depends on DIV_GPS_ENABLED
    range 0 48
    default 40
config DIV_GPS_TX
    int "GPS UART TX GPIO (-1 for receive only)"
    depends on DIV_GPS_ENABLED
    range -1 48
    default -1
config DIV_GPS_BAUD
    int "GPS baud rate"
    depends on DIV_GPS_ENABLED
    range 1200 115200
    default 9600
config DIV_PN532_ENABLED
    bool "External PN532 connected to I2C address 0x24"
    default n
config DIV_SERIAL_ENABLED
    bool "External serial monitor UART connected"
    default n
config DIV_SERIAL_RX
    int "Serial monitor RX GPIO"
    depends on DIV_SERIAL_ENABLED
    range 0 48
    default 41
config DIV_SERIAL_TX
    int "Serial monitor TX GPIO"
    depends on DIV_SERIAL_ENABLED
    range -1 48
    default 42
endmenu
```

## main/Kconfig.projbuild
```kconfig
menu "ESP32-DIV Board Configuration"

choice ESP32_DIV_BOARD
    prompt "Select target board"
    default ESP32_DIV_BOARD_V3
    help
        Pick the physical board wiring profile used by this build.

    config ESP32_DIV_BOARD_V3
        bool "ESP32-DIV V3"

    config ESP32_DIV_BOARD_V4
        bool "ESP32-DIV V4"
endchoice

config ESP32_DIV_TFT_PANEL_ILI9341
    bool "ILI9341"
    default y if ESP32_DIV_BOARD_V3
    depends on ESP32_DIV_BOARD_V3
    help
        3.2-inch panels on V3 use ILI9341.

config ESP32_DIV_TFT_PANEL_ST7796
    bool "ST7796 / ST7796S"
    default y if ESP32_DIV_BOARD_V4
    depends on ESP32_DIV_BOARD_V4
    help
        4-inch panels on V4 use ST7796/ST7796S.

config ESP32_DIV_PCF8574_ENABLED
    bool "Enable PCF8574 button expander"
    default y
    help
        Disable this if your board has no PCF8574 button expander.

config ESP32_DIV_PCF8574_ADDR
    hex "PCF8574 I2C address"
    default 0x20
    depends on ESP32_DIV_PCF8574_ENABLED
    help
        I2C address used for the PCF8574 button expander.

config ESP32_DIV_TOUCH_BUTTON_CUE_ENABLED
    int "Show on-screen touch nav bar"
    default 1
    range 0 1
    help
        Set to 0 to hide the footer touch navigation bar.

config ESP32_DIV_BUZZER_PIN
    int "Buzzer GPIO"
    default 2
    range -1 48
    help
        Set to -1 to disable buzzer initialization.

config ESP32_DIV_BUZZER_USE_PWM
    bool "Use PWM for buzzer"
    default n
    help
        Disable PWM for active buzzers that only need a digital output.

config ESP32_DIV_BUZZER_ACTIVE_LEVEL
    int "Buzzer active level"
    default 1
    range 0 1
    help
        GPIO level that makes the buzzer sound.

config ESP32_DIV_TFT_ROTATION
    int "TFT rotation"
    default 0
    range 0 3
    help
        Rotation applied to both TFT and touch input.

config ESP32_DIV_UI_SELF_TEST
    bool "Build UI self-test harness"
    default n
    help
        Build the isolated UI traversal harness used for hardware debug.

config ESP32_DIV_UI_SELF_TEST_AUTO_RUN
    bool "Auto-run UI self-test after boot"
    depends on ESP32_DIV_UI_SELF_TEST
    default n
    help
        Start the UI traversal harness once, four seconds after boot.

endmenu
```

## sdkconfig.defaults
```kconfig
CONFIG_IDF_TARGET="esp32s3"
CONFIG_ESPTOOLPY_FLASHSIZE_16MB=y
CONFIG_PARTITION_TABLE_CUSTOM=y
CONFIG_PARTITION_TABLE_CUSTOM_FILENAME="partitions.csv"
CONFIG_FREERTOS_HZ=1000
CONFIG_ESP_MAIN_TASK_STACK_SIZE=8192
CONFIG_COMPILER_OPTIMIZATION_SIZE=y
CONFIG_BT_ENABLED=y
CONFIG_BT_NIMBLE_ENABLED=y
CONFIG_BT_NIMBLE_ROLE_CENTRAL=y
CONFIG_BT_NIMBLE_ROLE_PERIPHERAL=y
CONFIG_BT_NIMBLE_ROLE_BROADCASTER=y
CONFIG_BT_NIMBLE_ROLE_OBSERVER=y
CONFIG_BT_NIMBLE_MAX_CONNECTIONS=1
CONFIG_BT_NIMBLE_NVS_PERSIST=y
CONFIG_ESP_CONSOLE_UART_DEFAULT=y
CONFIG_ESP_CONSOLE_SECONDARY_NONE=y
CONFIG_LV_COLOR_DEPTH_16=y
CONFIG_LV_MEM_SIZE_KILOBYTES=96
CONFIG_LV_FONT_MONTSERRAT_14=y
CONFIG_LV_USE_LOG=y
CONFIG_LV_LOG_LEVEL_WARN=y
CONFIG_LV_COLOR_16_SWAP=y
CONFIG_DIV_NRF3_ENABLED=y
CONFIG_DIV_GPIO2_BUZZER=y
```
